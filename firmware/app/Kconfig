## firmware/app/Kconfig
```kconfig
source "Kconfig.zephyr"

config APP_HIL_TEST
	bool "Hardware-in-the-loop test hooks"
	help
	  Watches the console for a command byte that forces the main loop
	  to hang, so a bench HIL rig can verify the watchdog actually
	  resets and recovers the unit -- something no host test can fake.
	  Only ever selected by firmware/hil/prj_hil.conf; must never be
	  enabled in a production build.

config APP_DEV_ECU_ON_USB
	bool "Dev: ECU link on the DK's USB serial port"
	help
	  Runs the ECU link without parity at the baud below, so a script on
	  a computer can play the ECU through the DK's USB serial bridge. Only
	  ever selected by firmware/dev/ecu_on_usb.conf; a gauge built this
	  way cannot talk to a car and must never ship.

config APP_DEV_ECU_BAUD
	int "Dev: ECU link baud"
	default 1953
	depends on APP_DEV_ECU_ON_USB

config APP_BLE_LOG
	bool "Stream ECU values over Bluetooth"
	help
	  Opens Bluetooth at boot and sends the ECU values as CSV lines to a
	  connected phone or computer (see ble_log.c). The passkey is random
	  each boot and is written to the console as "ble passkey NNNNNN".
	  Update mode reuses the same link and passkey. Bench use only: the
	  radio is on while driving.
```
